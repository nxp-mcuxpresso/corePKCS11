## Kconfig
```kconfig
#
# Copyright 2024,2025 NXP
#
# SPDX-License-Identifier: MIT
#

menuconfig MCUX_COMPONENT_middleware.freertos.corepkcs11
    bool "corepkcs11"
    default n
    help
        Software implementation of the PKCS #11 standard
    select MCUX_COMPONENT_middleware.pkcs11
    
config MCUX_COMPONENT_middleware.freertos.corepkcs11.template
    bool "template"
    depends on MCUX_COMPONENT_middleware.freertos.corepkcs11
    select MCUX_COMPONENT_middleware.freertos-kernel

config MCUX_COMPONENT_middleware.freertos.corepkcs11.mbedtls
    bool "mbedtls"
    depends on MCUX_COMPONENT_middleware.freertos.corepkcs11
    select MCUX_COMPONENT_middleware.pkcs11

config MCUX_COMPONENT_middleware.freertos.corepkcs11.mbedtls_utils
    bool "mbedtls_utils"
    depends on MCUX_COMPONENT_middleware.freertos.corepkcs11
    select MCUX_COMPONENT_middleware.pkcs11
```
